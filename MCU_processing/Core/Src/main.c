/* USER CODE BEGIN Header */
/**
  ******************************************************************************
  * @file           : main.c
  * @brief          : Main program body
  ******************************************************************************
  * @attention
  *
  * Copyright (c) 2023 STMicroelectronics.
  * All rights reserved.
  *
  * This software is licensed under terms that can be found in the LICENSE file
  * in the root directory of this software component.
  * If no LICENSE file comes with this software, it is provided AS-IS.
  *
  ******************************************************************************
  */
/* USER CODE END Header */
/* Includes ------------------------------------------------------------------*/
#include "main.h"
#include "adc.h"
#include "spi.h"
#include "ucpd.h"
#include "usart.h"
#include "usb_otg.h"
#include "gpio.h"

/* Private includes ----------------------------------------------------------*/
/* USER CODE BEGIN Includes */
#include "arm_math.h"
#include "arm_const_structs.h"
#include "sonar.h"
/* USER CODE END Includes */

/* Private typedef -----------------------------------------------------------*/
/* USER CODE BEGIN PTD */

/* USER CODE END PTD */

/* Private define ------------------------------------------------------------*/
/* USER CODE BEGIN PD */

const int EINT_STATUS_MASK =  1 << 23;
const int BINT_STATUS_MASK = 0x080000;
const int RRINT_STATUS_MASK = 0x000400;
const int FIFO_OVF_MASK =  0x7;
const int FIFO_VALID_SAMPLE_MASK =  0x0;
const int FIFO_FAST_SAMPLE_MASK =  0x1;
const int FIFO_RANGE_SAMPLE_MASK = 0x1;
const int ETAG_BITS_MASK = 0x7;
const int BTAG_BITS_MASK = 0x7;


#define NUM_STAGES_2ORDER 1 // Number of biquad stages
#define BLOCK_SIZE 1// Number of samples to process at a time
#define SAMPLE_RATE 32
#define PAST_SAMPLE_BUFFER (SAMPLE_RATE * 3) //sample rate * n, n decides the second in samples to look back at
#define NUM_TAPS 512
#define WINDOW_BASELINE 60*32*7
#define WINDOW 30*32

/* USER CODE END PD */

/* Private macro -------------------------------------------------------------*/
/* USER CODE BEGIN PM */

/* USER CODE END PM */

/* Private variables ---------------------------------------------------------*/

/* USER CODE BEGIN PV */
uint32_t idx;
int ecgFIFOIntFlag;
uint8_t receivedData[8];

float32_t phasicCoeffsFIR[NUM_TAPS] = {
    // Stage 1
		-8.07102186174787e-05,-8.12065045690491e-05,-8.17773022325704e-05,-8.24238547784548e-05,-8.31474115981145e-05,-8.39492283307793e-05,-8.48305668940252e-05,-8.57926955175458e-05,-8.6836888780736e-05,-8.79644276539039e-05,-8.91765995434061e-05,-9.04746983408026e-05,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8.07102186174787e-05
};

float32_t tonicCoeffsFIR[512] = {
    // Stage 1
		0.00027407666116661,0.000274340035646964,0.000274841507009337,0.000275581393217304,0.000276559973314694,0.000277777487342471,0.000279234136262187,0.000280930081886001,0.000282865446813298,0.000285040314373914,0.000287454728577989,0.000290108694072462,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0.00027407666116661
};

float32_t filteredCoeffsFIR[64] = {
		-0.000824653693879865,-0.000857063599528832,-0.000917709358691571,-0.000998343370055928,-0.00108384074801422,-0.0011523411588914,-0.00117581379933528,-0.00112103656571915,-0.000950957627525943,-0.000626385789779614,-0.000107936395438303,0.000641856829360566,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-0.000824653693879865
};

float32_t phasicCoeffs[NUM_STAGES_2ORDER*5] = {
    // Stage 1

		0.998266003962435,	-1.99653200792487,	0.998266003962435,	1.99652900118035,	-0.996535014669388
};
float32_t tonicCoeffs[NUM_STAGES_2ORDER*5] = {
    // Stage 1
		6.00307975164863e-06,	1.20061595032973e-05,	6.00307975164863e-06,	1.99305802314321,	-0.993082035462212
};
float32_t filteredCoeffs[NUM_STAGES_2ORDER*5] = {
    // Stage 1
		0.00490303497078511,	0.00980606994157022	,0.00490303497078511,	1.79238563711149,	-0.811997776994632
};
/* State buffer for the biquad filter */


static float32_t phasicState[NUM_TAPS+BLOCK_SIZE-1];
static float32_t tonicState[512+BLOCK_SIZE-1];
static float32_t filteredState[64+BLOCK_SIZE-1];


static arm_fir_instance_f32 S_phasic;
static arm_fir_instance_f32 S_tonic;
static arm_fir_instance_f32 S_filtered;

float32_t outputphasic[BLOCK_SIZE];
float32_t outputtonic[BLOCK_SIZE];
float32_t outputfiltered[BLOCK_SIZE];


uint32_t n_sample = 0;
float32_t conductanceSample[BLOCK_SIZE];
int32_t biozSample[BLOCK_SIZE];
float32_t reverseSample[BLOCK_SIZE];
uint32_t skip_sample = 0;


float32_t phasic_window[PAST_SAMPLE_BUFFER];

static  float32_t previous_1 = 0;
static  float32_t previous_2 = 0;
uint8_t valid_peak = 0;
float32_t peak[BLOCK_SIZE];
float32_t onset[BLOCK_SIZE];
float_t n_peak = 0;         //Puo benissimo essere uint8, ma torna meglio interpretare da python tutti i valori come float mentre legge i dati trasmessi

uint8_t SCR_rise_sample = 0;
float32_t SCR_risetime = 0;
float32_t risetime_mean = 0;
//float32_t old_risetime_mean = 0;
float32_t risetime_variance = 0;
float32_t risetime_std_dev = 0;
uint32_t risetime_count = 0;

float32_t tonic_mean = 0;
uint32_t tonic_count = 0;
uint16_t tonic_mean_settling = 0;
float32_t tonic_buffer[WINDOW];

float32_t phasic_mean = 0;
uint32_t phasic_count = 0;
uint16_t phasic_mean_settling = 0;
float32_t phasic_buffer[WINDOW];

float32_t max_tonic = 0;
uint16_t max_tonic_settling = 0;

uint32_t baseline_period = 0;
uint8_t baseline_calculated = 0;

float32_t conductance_mean = 0;
float32_t conductance_variance = 0;
float32_t conductance_std_dev = 0;
uint32_t conductance_count = 0;
float32_t conductance_buffer[WINDOW];

uint32_t window = 0;
uint32_t bufferIdx = 0;

float32_t features[5];
float32_t out;
/* USER CODE END PV */

/* Private function prototypes -----------------------------------------------*/
void SystemClock_Config(void);
static void SystemPower_Config(void);
/* USER CODE BEGIN PFP */

/* USER CODE END PFP */

/* Private user code ---------------------------------------------------------*/
/* USER CODE BEGIN 0 */
int _write(int file, char *ptr, int len){
	HAL_UART_Transmit(&huart1, (uint8_t*)ptr, len, HAL_MAX_DELAY);
	return len;
}

void Printing(){
	phasic_mean = 0;
	tonic_mean = 0;
	max_tonic = 0;
	n_peak = 0;
	risetime_std_dev = 0;

	phasic_count = 0;
	tonic_count = 0;
	risetime_count = 0;
}

void StdDev(float32_t sig, uint32_t* count, float32_t *average, float32_t *variance, float32_t *stddev){
	float32_t oldavg = *average;

	(*count)++;
	*average = *average + (sig-*average) / *count;
	(*variance) += ((sig - *average) * (sig - oldavg));

	arm_sqrt_f32(*variance/(*count), stddev);

}


void Local_Peak_and_Onset(float32_t signal,float32_t *peak, float32_t *onset, float32_t *peak_sum) {
	SCR_risetime = 0;
	if(valid_peak > 0){
	    		valid_peak--; // valid_peak pone un limite al phasic_window nel caso avessi trovato un vald peak
	    	}

    if (previous_1 > previous_2 && previous_1 > signal) {
    	previous_2 = previous_1;
    	previous_1 = signal;



    	float32_t lowest_point = phasic_window[1]; //Inizia con punto piu basso il primo sample passato per
    	SCR_rise_sample = 1;
		for (uint8_t i = 1; i < PAST_SAMPLE_BUFFER-valid_peak; i++) {	//Inzia ricerca del punto piu basso per trovare onset spostandomi un sample alla volta verso il passato
			if (phasic_window[i] < lowest_point) {
				SCR_rise_sample = i;			 //Rise time è uguale ad i siccome è il numero di sample tra onset e picco

				lowest_point = phasic_window[i];
			}
		}
		if (previous_2 - lowest_point > 2.6){  //3.112026184437658e-07 non normalized threshold
			*onset = lowest_point;
			*peak = previous_2;
			(*peak_sum)++; 						 //Somma picchi per trovare numero totale
			valid_peak = PAST_SAMPLE_BUFFER - 1; //valid peak assume il valore massimo del past buffer limitando il window fino a quel punto
			SCR_risetime = SCR_rise_sample; 	 //Trovo il valore del rise time del picco
			StdDev(SCR_risetime/32, &risetime_count, &risetime_mean, &risetime_variance, &risetime_std_dev);

		}
		else{
			*onset = 0;
			*peak = 0;


		}
    }
    else{
    	previous_2 = previous_1;
		previous_1 = signal;

		*onset = 0;
		*peak = 0;
    }
}

void Phasic_window(float32_t phasic){

	for (uint8_t i = PAST_SAMPLE_BUFFER; i > 0; i--) {
	        phasic_window[i - 1] = phasic_window[ i - 2]; //shifto a destra valore vecchio, applicando metodo FIFO giunto alla fine del buffer
	    }

	phasic_window[0] = phasic; //Salvo il valore piu nuovo all'inizio del buffer

}

void Max_Signal(float32_t signal, float32_t* max, uint16_t *settling){
	if (*max < signal){
			*max = signal;
		}


}

void HAL_UART_RxCpltCallback(UART_HandleTypeDef *huart){
	ecgFIFOIntFlag = 1;
}

void Mean(float32_t sig, uint32_t* count, float32_t *average, uint16_t *settling){
	(*count)++;
	*average = *average + (sig-*average) / *count;


}


/* USER CODE END 0 */

/**
  * @brief  The application entry point.
  * @retval int
  */
int main(void)
{
  /* USER CODE BEGIN 1 */

  /* USER CODE END 1 */

  /* MCU Configuration--------------------------------------------------------*/

  /* Reset of all peripherals, Initializes the Flash interface and the Systick. */
  HAL_Init();

  /* USER CODE BEGIN Init */

  /* USER CODE END Init */

  /* Configure the system clock */
  SystemClock_Config();

  /* Configure the System Power */
  SystemPower_Config();

  /* USER CODE BEGIN SysInit */

  /* USER CODE END SysInit */

  /* Initialize all configured peripherals */
  MX_GPIO_Init();
  MX_ADC1_Init();
  MX_UCPD1_Init();
  MX_USART1_UART_Init();
  MX_USB_OTG_FS_PCD_Init();
  MX_SPI1_Init();
  /* USER CODE BEGIN 2 */
  //max30003Config();
  //max30003BeginRtorMode(); 	//Configures and enable ECG/RTOR
  //max30001gBeginBIOZ(); 		//Configures and enable BIOZ

//  max30003ReadInfo();
//  max30003Printconf();

  arm_fir_init_f32(&S_phasic, NUM_TAPS, (float32_t*)phasicCoeffsFIR, phasicState, BLOCK_SIZE);
  arm_fir_init_f32(&S_tonic, 512, (float32_t*)tonicCoeffsFIR, tonicState, BLOCK_SIZE);
  arm_fir_init_f32(&S_filtered, 64, (float32_t*)filteredCoeffsFIR, filteredState, BLOCK_SIZE);
  /* USER CODE END 2 */

  /* Infinite loop */
  /* USER CODE BEGIN WHILE */
  while (1)
  {
    /* USER CODE END WHILE */

    /* USER CODE BEGIN 3 */


	  HAL_UART_Receive_IT(&huart1, receivedData, 8);
	  memcpy(&outputtonic, receivedData, sizeof(float32_t));
	  memcpy(&outputphasic, receivedData + 4, sizeof(float32_t));

	  if( ecgFIFOIntFlag ) {
		  ecgFIFOIntFlag = 0;
		  if (baseline_period == 0){

			  for (uint8_t i = 0; i < BLOCK_SIZE; i++) {

				  Phasic_window(outputphasic[i]);
				  Local_Peak_and_Onset(outputphasic[i], &peak[i], &onset[i], &n_peak);
				  Mean(outputtonic[i], &tonic_count, &tonic_mean, &tonic_mean_settling);
				  Mean(outputphasic[i], &phasic_count, &phasic_mean, &phasic_mean_settling);
				  Max_Signal(outputtonic[i], &max_tonic, &max_tonic_settling);

				  features[0] = tonic_mean;
			      features[1] = phasic_mean;
			      features[2] = max_tonic;
			      features[3] = n_peak;
			      features[4] = risetime_std_dev;



				  if (window > 32*30 - 1){

					  out = sonar_predict(features, 5);
					  tonic_mean = 0;
					  phasic_mean = 0;
					  tonic_count = 0;
					  phasic_count = 0;
					  max_tonic = 0;
					  n_peak = 0;
					  risetime_std_dev = 0;
					  risetime_mean = 0;
					  risetime_variance = 0;
					  risetime_count = 0;
					  HAL_UART_Transmit(&huart1, (uint8_t*)&out, 4, HAL_MAX_DELAY);
					  valid_peak = PAST_SAMPLE_BUFFER - 1;

					  window = 0;
				  }
				  else{

					  window++;
				  }
			  }
		  }
		  else{
			  StdDev(conductanceSample[0], &conductance_count, &conductance_mean, &conductance_variance, &conductance_std_dev);
			  baseline_period++;
		  }
		}
	  }
  /* USER CODE END 3 */
}

/**
  * @brief System Clock Configuration
  * @retval None
  */
void SystemClock_Config(void)
{
  RCC_OscInitTypeDef RCC_OscInitStruct = {0};
  RCC_ClkInitTypeDef RCC_ClkInitStruct = {0};

  /** Configure the main internal regulator output voltage
  */
  if (HAL_PWREx_ControlVoltageScaling(PWR_REGULATOR_VOLTAGE_SCALE1) != HAL_OK)
  {
    Error_Handler();
  }

  /** Initializes the CPU, AHB and APB buses clocks
  */
  RCC_OscInitStruct.OscillatorType = RCC_OSCILLATORTYPE_HSI48|RCC_OSCILLATORTYPE_HSI
                              |RCC_OSCILLATORTYPE_MSI;
  RCC_OscInitStruct.HSIState = RCC_HSI_ON;
  RCC_OscInitStruct.HSI48State = RCC_HSI48_ON;
  RCC_OscInitStruct.HSICalibrationValue = RCC_HSICALIBRATION_DEFAULT;
  RCC_OscInitStruct.MSIState = RCC_MSI_ON;
  RCC_OscInitStruct.MSICalibrationValue = RCC_MSICALIBRATION_DEFAULT;
  RCC_OscInitStruct.MSIClockRange = RCC_MSIRANGE_4;
  RCC_OscInitStruct.PLL.PLLState = RCC_PLL_ON;
  RCC_OscInitStruct.PLL.PLLSource = RCC_PLLSOURCE_MSI;
  RCC_OscInitStruct.PLL.PLLMBOOST = RCC_PLLMBOOST_DIV1;
  RCC_OscInitStruct.PLL.PLLM = 1;
  RCC_OscInitStruct.PLL.PLLN = 80;
  RCC_OscInitStruct.PLL.PLLP = 2;
  RCC_OscInitStruct.PLL.PLLQ = 2;
  RCC_OscInitStruct.PLL.PLLR = 2;
  RCC_OscInitStruct.PLL.PLLRGE = RCC_PLLVCIRANGE_0;
  RCC_OscInitStruct.PLL.PLLFRACN = 0;
  if (HAL_RCC_OscConfig(&RCC_OscInitStruct) != HAL_OK)
  {
    Error_Handler();
  }

  /** Initializes the CPU, AHB and APB buses clocks
  */
  RCC_ClkInitStruct.ClockType = RCC_CLOCKTYPE_HCLK|RCC_CLOCKTYPE_SYSCLK
                              |RCC_CLOCKTYPE_PCLK1|RCC_CLOCKTYPE_PCLK2
                              |RCC_CLOCKTYPE_PCLK3;
  RCC_ClkInitStruct.SYSCLKSource = RCC_SYSCLKSOURCE_PLLCLK;
  RCC_ClkInitStruct.AHBCLKDivider = RCC_SYSCLK_DIV1;
  RCC_ClkInitStruct.APB1CLKDivider = RCC_HCLK_DIV1;
  RCC_ClkInitStruct.APB2CLKDivider = RCC_HCLK_DIV1;
  RCC_ClkInitStruct.APB3CLKDivider = RCC_HCLK_DIV1;

  if (HAL_RCC_ClockConfig(&RCC_ClkInitStruct, FLASH_LATENCY_4) != HAL_OK)
  {
    Error_Handler();
  }
}

/**
  * @brief Power Configuration
  * @retval None
  */
static void SystemPower_Config(void)
{

  /*
   * Switch to SMPS regulator instead of LDO
   */
  if (HAL_PWREx_ConfigSupply(PWR_SMPS_SUPPLY) != HAL_OK)
  {
    Error_Handler();
  }
/* USER CODE BEGIN PWR */
/* USER CODE END PWR */
}

/* USER CODE BEGIN 4 */

/* USER CODE END 4 */

/**
  * @brief  This function is executed in case of error occurrence.
  * @retval None
  */
void Error_Handler(void)
{
  /* USER CODE BEGIN Error_Handler_Debug */
  /* User can add his own implementation to report the HAL error return state */
  __disable_irq();
  while (1)
  {
  }
  /* USER CODE END Error_Handler_Debug */
}

#ifdef  USE_FULL_ASSERT
/**
  * @brief  Reports the name of the source file and the source line number
  *         where the assert_param error has occurred.
  * @param  file: pointer to the source file name
  * @param  line: assert_param error line source number
  * @retval None
  */
void assert_failed(uint8_t *file, uint32_t line)
{
  /* USER CODE BEGIN 6 */
  /* User can add his own implementation to report the file name and line number,
     ex: printf("Wrong parameters value: file %s on line %d\r\n", file, line) */
  /* USER CODE END 6 */
}
#endif /* USE_FULL_ASSERT */
